## boards/shields/gametrack/Kconfig.defconfig
```kconfig
if SHIELD_gametrack_LEFT

# Name must be less than 16 characters long!
config ZMK_KEYBOARD_NAME
    default "gametrack"

config ZMK_SPLIT_ROLE_CENTRAL
    default y

endif

if SHIELD_gametrack_LEFT || SHIELD_gametrack_RIGHT

config ZMK_SPLIT
    default y

endif
```

## boards/shields/gametrack/Kconfig.shield
```kconfig
config SHIELD_gametrack_LEFT
    def_bool $(shields_list_contains,gametrack_left)

# No whitespace after the comma or in your part name!
config SHIELD_gametrack_RIGHT
    def_bool $(shields_list_contains,gametrack_right)
```

## config/boards/shields/gametrack/Kconfig.defconfig
```kconfig
if SHIELD_GAMETRACK_RIGHT

config ZMK_KEYBOARD_NAME
    default "gametrack"

config ZMK_SPLIT_ROLE_CENTRAL
    default y

endif

if SHIELD_GAMETRACK_LEFT || SHIELD_GAMETRACK_RIGHT

config ZMK_SPLIT
    default y

config ZMK_POINTING
    default y

config SPI
    default y

endif
```

## config/boards/shields/gametrack/Kconfig.shield
```kconfig
config SHIELD_GAMETRACK_LEFT
    def_bool $(shields_list_contains,gametrack_left)

config SHIELD_GAMETRACK_RIGHT
    def_bool $(shields_list_contains,gametrack_right)
```
